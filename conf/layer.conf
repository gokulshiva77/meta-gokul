## conf/layer.conf
```bitbake
# We have a conf and classes directory, add to BBPATH
BBPATH .= ":${LAYERDIR}"

# We have recipes-* directories, add to BBFILES
BBFILES += "${LAYERDIR}/recipes-*/*/*.bb \
            ${LAYERDIR}/recipes-*/*/*.bbappend"

BBFILE_COLLECTIONS += "meta-gokul"
BBFILE_PATTERN_meta-gokul = "^${LAYERDIR}/"
BBFILE_PRIORITY_meta-gokul = "6"

LAYERDEPENDS_meta-gokul = "core"
LAYERSERIES_COMPAT_meta-gokul = "walnascar"
```

## conf/machine/gokul-pi.inc
```bitbake
# gokul-pi.inc - custom machine for Yocto, based on Raspberry Pi 4
require conf/machine/raspberrypi4.conf

# Custom overrides and additions
MACHINEOVERRIDES .= ":gokul-pi"

# Kernel configuration for gokul-pi machine
KBUILD_DEFCONFIG:gokul-pi ?= "bcm2711_defconfig"

#Enable Uart
ENABLE_UART = "1"

IMAGE_FSTYPES = "wic.gz ext4"
WKS_FILE = "gokul-image.wks"

DISTRO_FEATURES:append = " usrmerge systemd"
DISTRO_FEATURES:remove = "sysvinit"

# Force the use of systemd as the init manager
VIRTUAL-RUNTIME_init_manager = "systemd"

MACHINE_EXTRA_RRECOMMENDS:append = " linux-can-driver"

CORE_IMAGE_EXTRA_INSTALL += "iw \
                            wpa-supplicant \
                            hostapd \
                            openssh \
                            rsync\
                            linux-can-driver \
                            linux-can-sdk \
                            "
IMAGE_FEATURES:append = " serial-autologin-root"

CORE_IMAGE_EXTRA_INSTALL += " ldd \
                            minicom \
                            net-tools \
                            dpkg \
                            apt \
                            tar \
                            packagegroup-core-buildessential \
                            bridge-utils \
                            hostapd \
                            nano \
                            iptables \
                            vim \
                            "
# CORE_IMAGE_EXTRA_INSTALL += " populate-rootfs-b"
```

## recipes-core/images/gokul-image.wks
```
# Boot partition (FAT32)
part boot --source bootimg-partition --ondisk mmcblk0 --fstype=vfat --label boot --size=64 --active

# rootfsA (ext4)
part --source rootfs --ondisk mmcblk0 --fstype=ext4 --label rootfsA --size=2048

# rootfsB (ext4)
part --ondisk mmcblk0 --fstype=ext4 --label rootfsB --size=2048

#optional data partition (ext4)
part --ondisk mmcblk0 --fstype=ext4 --label data --size=512
```
